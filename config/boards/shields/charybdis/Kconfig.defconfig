## config/boards/shields/charybdis/Kconfig.defconfig
```kconfig
if SHIELD_CHARYBDIS_RIGHT

	config ZMK_KEYBOARD_NAME
		string "Sonny's Charybdis"

	config ZMK_SPLIT_BLE_ROLE_CENTRAL
		default y

	config BT_DIS_MODEL
    		default ZMK_KEYBOARD_NAME

endif

if SHIELD_CHARYBDIS_LEFT || SHIELD_CHARYBDIS_RIGHT

	config ZMK_SPLIT
		default y

endif
```
